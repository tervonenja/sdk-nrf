## CMakeLists.txt
```
#
# Copyright (c) 2026 Nordic Semiconductor ASA
#
# SPDX-License-Identifier: LicenseRef-Nordic-5-Clause
#

cmake_minimum_required(VERSION 3.20.0)

find_package(Zephyr REQUIRED HINTS $ENV{ZEPHYR_BASE})
project(remote)

zephyr_include_directories(../include)

target_sources(app PRIVATE
  src/main.c
  ../src/mram_worker.c
)
```

## prj.conf
```kconfig
CONFIG_FLASH=y
CONFIG_FLASH_MAP=y
CONFIG_ASSERT=y

CONFIG_CONSOLE=n
CONFIG_UART_CONSOLE=n
CONFIG_SERIAL=n
CONFIG_BOOT_BANNER=n
CONFIG_NCS_BOOT_BANNER=n
```

## boards/nrf9251dk_nrf9251_cpuflpr.conf
```kconfig
CONFIG_SERIAL=y
CONFIG_CONSOLE=y
CONFIG_UART_CONSOLE=y
CONFIG_PRINTK=y
CONFIG_BOOT_BANNER=n
CONFIG_NCS_BOOT_BANNER=n
```

## boards/nrf9251dk_nrf9251_cpuflpr.overlay
```dts
/*
 * Copyright (c) 2026 Nordic Semiconductor ASA
 *
 * SPDX-License-Identifier: LicenseRef-Nordic-5-Clause
 */

&storage_partition {
	status = "okay";
};

/* Route this core's console to uart120 for debug prints. */
/ {
	chosen {
		zephyr,console = &uart120;
	};
};

&uart120 {
	status = "okay";
};
```

## boards/nrf9251dk_nrf9251_cpuppr.overlay
```dts
/*
 * Copyright (c) 2026 Nordic Semiconductor ASA
 *
 * SPDX-License-Identifier: LicenseRef-Nordic-5-Clause
 */

&storage_partition {
	status = "okay";
};

/* Route this core's console to uart132 for debug prints. */
/ {
	chosen {
		zephyr,console = &uart132;
	};
};

&uart132 {
	status = "okay";
};
```

## src/main.c
```c
/*
 * Copyright (c) 2026 Nordic Semiconductor ASA
 *
 * SPDX-License-Identifier: LicenseRef-Nordic-5-Clause
 */

#include <zephyr/kernel.h>
#include <zephyr/devicetree.h>

#include "mram_concurrent.h"

#if defined(CONFIG_SOC_NRF9251_CPUPPR)
#define CORE_ID	    MRAM_CORE_PPR
#define STATUS_ADDR MRAM_PPR_STATUS_ADDR
#define CTRL_ADDR   MRAM_PPR_CTRL_ADDR
#elif defined(CONFIG_SOC_NRF9251_CPUFLPR)
#define CORE_ID	    MRAM_CORE_FLPR
#define STATUS_ADDR MRAM_FLPR_STATUS_ADDR
#define CTRL_ADDR   MRAM_FLPR_CTRL_ADDR
#else
#error "Unsupported remote core for the concurrent MRAM test"
#endif

static volatile struct mram_test_status *const status = (struct mram_test_status *)STATUS_ADDR;
static volatile struct mram_test_control *const ctrl = (struct mram_test_control *)CTRL_ADDR;

int main(void)
{
	(void)mram_writer_run(CORE_ID, (struct mram_test_status *)status, ctrl);

	return 0;
}
```
